## conf/layer.conf
```bitbake
# We have a conf and classes directory, add to BBPATH
BBPATH .= ":${LAYERDIR}"

# We have recipes-* directories, add to BBFILES
BBFILES += "${LAYERDIR}/recipes-*/*.bb"
BBFILES += "${LAYERDIR}/recipes-*/*.bbappend"
BBFILES += "${LAYERDIR}/recipes-*/*/*.bb"
BBFILES += "${LAYERDIR}/recipes-*/*/*.bbappend"


BBFILE_COLLECTIONS += "hsiao"
BBFILE_PATTERN_hsiao = "^${LAYERDIR}/"
# Layer 的優先順序，數字越高越優先
BBFILE_PRIORITY_hsiao = "10"

# 相容的 Yocto 版本（styhead 是 Kirkstone 分支）
LAYERSERIES_COMPAT_hsiao = "styhead"
```
